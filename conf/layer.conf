## conf/layer.conf
```bitbake
# We have a conf and classes directory, add to BBPATH
BBPATH .= ":${LAYERDIR}"

# We have recipes-* directories, add to BBFILES
BBFILES += "${LAYERDIR}/recipes-*/*/*.bb \
            ${LAYERDIR}/recipes-*/*/*.bbappend"

BBFILE_COLLECTIONS += "meta-port4949"
BBFILE_PATTERN_meta-port4949 = "^${LAYERDIR}/"
BBFILE_PRIORITY_meta-port4949 = "11"

LAYERDEPENDS_meta-port4949 = "core"
LAYERSERIES_COMPAT_meta-port4949 = "dunfell"
```
